## conf/layer.conf
```bitbake
# We have a conf and classes directory, add to BBPATH
BBPATH .= ":${LAYERDIR}"

# We have recipes-* directories, add to BBFILES
BBFILES += "${LAYERDIR}/recipes-*/*/*.bb \
			${LAYERDIR}/recipes-*/*/*.bbappend"

BBFILE_COLLECTIONS += "quectel-community"
BBFILE_PATTERN_quectel-community = "^${LAYERDIR}/"
BBFILE_PRIORITY_quectel-community = "5"
```
